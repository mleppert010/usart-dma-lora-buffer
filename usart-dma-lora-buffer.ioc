# file: usart-dma-lora-buffer.ioc
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Mcu.Family=STM32G4
Mcu.Name=STM32G474C(B-C-E)Ux
Mcu.Package=UFQFPN48
NVIC.PriorityGroup=NVIC_PRIORITYGROUP_4
ProjectManager.HeapSize=0x200
ProjectManager.StackSize=0x400
ProjectManager.TargetToolchain=Makefile
RCC.ADC12Freq_Value=170000000
RCC.ADC345Freq_Value=170000000
RCC.AHBFreq_Value=170000000
RCC.APB1Freq_Value=170000000
RCC.APB1TimFreq_Value=170000000
RCC.APB2Freq_Value=170000000
RCC.APB2TimFreq_Value=170000000
RCC.CortexFreq_Value=170000000
RCC.EXTERNAL_CLOCK_VALUE=12288000
RCC.HCLKFreq_Value=170000000
RCC.HSE_VALUE=8000000
RCC.HSI48_VALUE=48000000
RCC.HSI_VALUE=16000000
RCC.LSE_VALUE=32768
RCC.PLLM=RCC_PLLM_DIV4
RCC.PLLN=85
RCC.SYSCLKFreq_VALUE=170000000
RCC.SYSCLKSource=RCC_SYSCLKSOURCE_PLLCLK
RCC.USBFreq_Value=170000000
RCC.VCOOutputFreq_Value=340000000
VP_SYS_VS_DBSignals.Mode=DisableDeadBatterySignals
board=custom

// file: Core/Src/main.c
/* USER CODE BEGIN Header */
/**
 ******************************************************************************
 * @file           : main.c
 * @brief          : Main program body
 ******************************************************************************
 * @attention
 *
 * Copyright (c) 2025 STMicroelectronics.
 * All rights reserved.
 *
 * This software is licensed under terms that can be found in the LICENSE file
 * in the root directory of this software component.
 * If no LICENSE file comes with this software, it is provided AS-IS.
 *
 ******************************************************************************
 */
/* USER CODE END Header */
#include "main.h"

/* USER CODE BEGIN Includes */

#include <stdint.h>
#include <stdlib.h>
#include <string.h>
#include <stdio.h>

#include "lwrb.h"

/* USER CODE END Includes */

/* USER CODE BEGIN PTD */

/**
 * \brief           Structure of UART associated buffers and indexes
 */
typedef struct {
    lwrb_t tx_rb; /**< TX ring buffer for DMA to read out */
    uint8_t tx_rb_data[384]; /**< TX ring buffer data */
    volatile size_t tx_dma_current_len; /**< Current TX DMA transfer length */
    lwrb_t rx_process_rb; /**< RX data processing ring buffer */
    uint8_t rx_process_rb_data[384]; /**< RX data processing ring buffer data */
    uint8_t rx_dma_buff[64]; /**< RX circular buffer for DMA to write to */
    size_t old_pos; /**< Previous DMA write to index */
} uart_buff_t;

/**
 * \brief           Structure of TX DMA controller, channel, and associated flag clearing functions for a UART
 */
typedef struct {
    DMA_TypeDef* controller; /**< DMA controller (DMA1/DMA2) */
    uint32_t channel; /**< DMA Channel */
    void (*clear_flag_TC)(DMA_TypeDef*); /**< Channel specific function pointer to clear TC flag */
    void (*clear_flag_HT)(DMA_TypeDef*); /**< Channel specific function pointer to clear HT flag */
    void (*clear_flag_GI)(DMA_TypeDef*); /**< Channel specific function pointer to clear GI flag */
    void (*clear_flag_TE)(DMA_TypeDef*); /**< Channel specific function pointer to clear TE flag */
} dma_tx_t;

/* USER CODE END PTD */

/* USER CODE BEGIN PD */

/**
 * \brief           Should tx be looped back
 */
#define LOOPBACK 0

/**
 * \brief           Calculate length of statically allocated array
 */
#define ARRAY_LEN(x) (sizeof(x) / sizeof((x)[0]))

/* USER CODE END PD */

/* USER CODE BEGIN PV */

uart_buff_t lpuart1_buff, usart1_buff;

dma_tx_t lpuart1_dma, usart1_dma;

/**
 * \brief           Ring buffer instance for TX data
 */
//lwrb_t lpuart1_tx_rb, usart1_tx_rb;

/**
 * \brief           Ring buffer data array for TX DMA
 */
//uint8_t lpuart1_tx_rb_data[384], usart1_tx_rb_data[384];

/**
 * \brief           Length of currently active TX DMA transfer
 */
//volatile size_t lpuart1_tx_dma_current_len, usart1_tx_dma_current_len;

/**
 * \brief           USART RX buffer for DMA to transfer every received byte
 * \note            Contains raw data that are about to be processed by different events
 */
//uint8_t lpuart1_rx_dma_buff[64], usart1_rx_dma_buff[64];

/**
 * \brief           DMA RX buffer previous position counter
 */
//size_t lpuart1_old_pos, usart1_old_pos;

/**
 * \brief           Ring buffer instance for processing buffer
 */
//lwrb_t lpuart1_rx_process_rb, usart1_rx_process_rb;

/**
 * \brief           Ring buffer data array for processing
 */
//uint8_t lpuart1_rx_process_rb_data[384], usart1_rx_process_rb_data[384];

/* USER CODE END PV */

void SystemClock_Config(void);

/* USER CODE BEGIN PFP */

void lpuart1_init(void);
void usart1_init(void);
void uart_rx_check(uart_buff_t* uart_buff);
void uart_process_data(uart_buff_t* uart_buff, const void* data, size_t len);
void uart_send_string(uart_buff_t* uart_buff, dma_tx_t* dma_tx, const char* str);
void uart_send_data(uart_buff_t* uart_buff, dma_tx_t* dma_tx, const void* data, size_t len);
uint8_t uart_start_tx_dma_transfer(uart_buff_t* uart_buff, dma_tx_t* dma_tx);
uint8_t find_crlf(uart_buff_t* uart_buff, size_t peekahead, uint8_t* old_char);
void process_char_loop(uart_buff_t* uart_buff, size_t peekahead, uint8_t* old_char);
uint8_t rylr_send_string(uart_buff_t* uart_buff, dma_tx_t* dma_tx, uint16_t address, char* str);
uint8_t rylr_send_data(uart_buff_t* uart_buff, dma_tx_t* dma_tx, uint16_t add, void* data, size_t len);

/* USER CODE END PFP */

int main(void) {
    /* USER CODE BEGIN 1 */
    size_t write_len, peekahead;
    uint8_t old_char = 0;

    peekahead = 0;

    /* USER CODE END 1 */

    /* MCU Configuration--------------------------------------------------------*/

    /* Reset of all peripherals, Initializes the Flash interface and the Systick. */
    LL_APB2_GRP1_EnableClock(LL_APB2_GRP1_PERIPH_SYSCFG);
    LL_APB1_GRP1_EnableClock(LL_APB1_GRP1_PERIPH_PWR);

    /* System interrupt init*/
    NVIC_SetPriorityGrouping(NVIC_PRIORITYGROUP_4);

    /* SysTick_IRQn interrupt configuration */
    NVIC_SetPriority(SysTick_IRQn, NVIC_EncodePriority(NVIC_GetPriorityGrouping(), 15, 0));

    /** Disable the internal Pull-Up in Dead Battery pins of UCPD peripheral
     */
    LL_PWR_DisableUCPDDeadBattery();

    /* Configure the system clock */
    SystemClock_Config();

    /* Initialize all configured peripherals */
    /* USER CODE BEGIN 2 */

    /* Initialize lpuart1 tx ringbuff */
    lwrb_init(&lpuart1_buff.tx_rb, lpuart1_buff.tx_rb_data, sizeof(lpuart1_buff.tx_rb_data));

    /* Initialize lpuart1 rx processing ringbuffer */
    lwrb_init(&lpuart1_buff.rx_process_rb, lpuart1_buff.rx_process_rb_data, sizeof(lpuart1_buff.rx_process_rb_data));

    /* Initialize usart1 tx ringbuff */
    lwrb_init(&usart1_buff.tx_rb, usart1_buff.tx_rb_data, sizeof(usart1_buff.tx_rb_data));

    /* Initialize usart1 rx processing ringbuffer */
    lwrb_init(&usart1_buff.rx_process_rb, usart1_buff.rx_process_rb_data, sizeof(usart1_buff.rx_process_rb_data));

    /* Initialize all configured peripherals */
    lpuart1_init();
    usart1_init();

    /* Notify user to start sending data */
    uart_send_string(&lpuart1_buff, &lpuart1_dma, "UART DMA example: DMA HT & TC + USART IDLE LINE IRQ\r\n");
    uart_send_string(&lpuart1_buff, &lpuart1_dma, "Start sending data to STM32\r\n");

    rylr_send_string(&usart1_buff, &usart1_dma, 325, "This is a test message");

    uint8_t data[] = {0xDB, 0xDB, 0xDB, 0xDb, 0xFE, 0xFE, 0xFE, 0xFE};
    rylr_send_data(&usart1_buff, &usart1_dma, 25565, data, 8);

    /* USER CODE END 2 */

    /* Infinite loop */
    while (1) {

        /* USER CODE BEGIN 3 */

        if (!LOOPBACK) {
            if (peekahead < lwrb_get_full(&lpuart1_buff.rx_process_rb)) {
                if(find_crlf(&lpuart1_buff, peekahead, &old_char)) {
                    write_len = lwrb_get_linear_block_read_length(&lpuart1_buff.rx_process_rb);
                    uart_send_data(&usart1_buff, &usart1_dma, lwrb_get_linear_block_read_address(&lpuart1_buff.rx_process_rb), write_len);
                    lwrb_skip(&lpuart1_buff.rx_process_rb, write_len);
                    if((write_len = lwrb_get_linear_block_read_length(&lpuart1_buff.rx_process_rb)) > 0) {
                        uart_send_data(&usart1_buff, &usart1_dma, lwrb_get_linear_block_read_address(&lpuart1_buff.rx_process_rb), write_len);
                        lwrb_skip(&lpuart1_buff.rx_process_rb, write_len);
                    }
                    peekahead = 0;
                } else {
                    ++peekahead;
                }
            }
        } else {
            if (peekahead < lwrb_get_full(&lpuart1_buff.rx_process_rb)) {

            }
        }
    }
    /* USER CODE END 3 */
}

void SystemClock_Config(void) {
    LL_FLASH_SetLatency(LL_FLASH_LATENCY_4);
    while (LL_FLASH_GetLatency() != LL_FLASH_LATENCY_4) {
    }
    LL_PWR_EnableRange1BoostMode();
    LL_RCC_HSI_Enable();
    /* Wait till HSI is ready */
    while (LL_RCC_HSI_IsReady() != 1) {
    }

    LL_RCC_HSI_SetCalibTrimming(64);
    LL_RCC_PLL_ConfigDomain_SYS(LL_RCC_PLLSOURCE_HSI, LL_RCC_PLLM_DIV_4, 85, LL_RCC_PLLR_DIV_2);
    LL_RCC_PLL_EnableDomain_SYS();
    LL_RCC_PLL_Enable();
    /* Wait till PLL is ready */
    while (LL_RCC_PLL_IsReady() != 1) {
    }

    LL_RCC_SetSysClkSource(LL_RCC_SYS_CLKSOURCE_PLL);
    LL_RCC_SetAHBPrescaler(LL_RCC_SYSCLK_DIV_2);
    /* Wait till System clock is ready */
    while (LL_RCC_GetSysClkSource() != LL_RCC_SYS_CLKSOURCE_STATUS_PLL) {
    }

    /* Insure 1us transition state at intermediate medium speed clock*/
    for (__IO uint32_t i = (170 >> 1); i != 0; i--);

    /* Set AHB prescaler*/
    LL_RCC_SetAHBPrescaler(LL_RCC_SYSCLK_DIV_1);
    LL_RCC_SetAPB1Prescaler(LL_RCC_APB1_DIV_1);
    LL_RCC_SetAPB2Prescaler(LL_RCC_APB2_DIV_1);

    LL_Init1msTick(170000000);

    LL_SetSystemCoreClock(170000000);
}

/* USER CODE BEGIN 4 */

/**
 * \brief           Check for new data received with DMA
 * \param[in]       uart_buff: UART peripheral buffers to use
 *
 * User must select context to call this function from:
 * - Only interrupts (DMA HT, DMA TC, UART IDLE) with same preemption priority level
 * - Only thread context (outside interrupts)
 *
 * If called from both context-es, exclusive access protection must be implemented
 * This mode is not advised as it usually means architecture design problems
 *
 * When IDLE interrupt is not present, application must rely only on thread context,
 * by manually calling function as quickly as possible, to make sure
 * data are read from raw buffer and processed.
 *
 * Not doing reads fast enough may cause DMA to overflow unread received bytes,
 * hence application will lost useful data.
 *
 * Solutions to this are:
 * - Improve architecture design to achieve faster reads
 * - Increase raw buffer size and allow DMA to write more data before this function is called
 */
void uart_rx_check(uart_buff_t* uart_buff) {
    size_t pos;

    /* Calculate current position in buffer and check for new data available */
    pos = ARRAY_LEN(uart_buff->rx_dma_buff) - LL_DMA_GetDataLength(DMA1, LL_DMA_CHANNEL_1);
    if (pos != uart_buff->old_pos) {                       /* Check change in received data */
        if (pos > uart_buff->old_pos) {                    /* Current position is over previous one */
            /*
             * Processing is done in "linear" mode.
             *
             * Application processing is fast with single data block,
             * length is simply calculated by subtracting pointers
             *
             * [   0   ]
             * [   1   ] <- old_pos |------------------------------------|
             * [   2   ]            |                                    |
             * [   3   ]            | Single block (len = pos - old_pos) |
             * [   4   ]            |                                    |
             * [   5   ]            |------------------------------------|
             * [   6   ] <- pos
             * [   7   ]
             * [ N - 1 ]
             */
            uart_process_data(uart_buff, &uart_buff->rx_dma_buff[uart_buff->old_pos], pos - uart_buff->old_pos);
        } else {
            /*
             * Processing is done in "overflow" mode..
             *
             * Application must process data twice,
             * since there are 2 linear memory blocks to handle
             *
             * [   0   ]            |---------------------------------|
             * [   1   ]            | Second block (len = pos)        |
             * [   2   ]            |---------------------------------|
             * [   3   ] <- pos
             * [   4   ] <- old_pos |---------------------------------|
             * [   5   ]            |                                 |
             * [   6   ]            | First block (len = N - old_pos) |
             * [   7   ]            |                                 |
             * [ N - 1 ]            |---------------------------------|
             */
            uart_process_data(uart_buff, &uart_buff->rx_dma_buff[uart_buff->old_pos], ARRAY_LEN(uart_buff->rx_dma_buff) - uart_buff->old_pos);
            if (pos > 0) {
                uart_process_data(uart_buff, &uart_buff->rx_dma_buff[0], pos);
            }
        }
        uart_buff->old_pos = pos;                          /* Save current position as old for next transfers */
    }
}

/**
 * \brief           Check if DMA is active and if not try to send data
 * \return          `1` if transfer just started, `0` if on-going or no data to transmit
 * \param[in]       uart_buff: UART peripheral buffers to use
 * \param[in]       dma_tx: DMA controller, channel, and interrupt flag clearing functions
 */
uint8_t uart_start_tx_dma_transfer(uart_buff_t* uart_buff, dma_tx_t* dma_tx) {
    uint32_t primask;
    uint8_t started = 0;

    /*
     * First check if transfer is currently in-active,
     * by examining the value of tx_dma_current_len variable.
     *
     * This variable is set before DMA transfer is started and cleared in DMA TX complete interrupt.
     *
     * It is not necessary to disable the interrupts before checking the variable:
     *
     * When tx_dma_current_len == 0
     *    - This function is called by either application or TX DMA interrupt
     *    - When called from interrupt, it was just reset before the call,
     *         indicating transfer just completed and ready for more
     *    - When called from an application, transfer was previously already in-active
     *         and immediate call from interrupt cannot happen at this moment
     *
     * When tx_dma_current_len != 0
     *    - This function is called only by an application.
     *    - It will never be called from interrupt with tx_dma_current_len != 0 condition
     *
     * Disabling interrupts before checking for next transfer is advised
     * only if multiple operating system threads can access to this function w/o
     * exclusive access protection (mutex) configured,
     * or if application calls this function from multiple interrupts.
     *
     * This example assumes worst use case scenario,
     * hence interrupts are disabled prior every check
     */
    primask = __get_PRIMASK();
    __disable_irq();
    if (uart_buff->tx_dma_current_len == 0
            && (uart_buff->tx_dma_current_len = lwrb_get_linear_block_read_length(&uart_buff->tx_rb)) > 0) {
        /* Disable channel if enabled */
        LL_DMA_DisableChannel(dma_tx->controller, dma_tx->channel);

        /* Clear all flags */
        dma_tx->clear_flag_TC(dma_tx->controller);
        dma_tx->clear_flag_HT(dma_tx->controller);
        dma_tx->clear_flag_GI(dma_tx->controller);
        dma_tx->clear_flag_TE(dma_tx->controller);

        /* Prepare DMA data and length */
        LL_DMA_SetDataLength(dma_tx->controller, dma_tx->channel, uart_buff->tx_dma_current_len);
        LL_DMA_SetMemoryAddress(dma_tx->controller, dma_tx->channel, (uint32_t)lwrb_get_linear_block_read_address(&uart_buff->tx_rb));

        /* Start transfer */
        LL_DMA_EnableChannel(dma_tx->controller, dma_tx->channel);
        started = 1;
    }
    __set_PRIMASK(primask);
    return started;
}

/**
 * \brief           Process received data over UART
 * \note            Either process them directly or copy to other bigger buffer
 * \param[in]       uart_buff: UART peripheral buffers to use
 * \param[in]       data: Data to process
 * \param[in]       len: Length in units of bytes
 */
void uart_process_data(uart_buff_t* uart_buff, const void* data, size_t len) {
    lwrb_write(&uart_buff->rx_process_rb, data, len);        /* Write data to RX processing buffer for character analysis */
}

/**
 * \brief           Send string to UART
 * \note            Will queue to send if DMA transfer in progress
 * \param[in]       uart_buff: UART peripheral buffers to use
 * \param[in]       str: String to send
 */
void uart_send_string(uart_buff_t* uart_buff, dma_tx_t* dma_tx, const char* str) {
    lwrb_write(&uart_buff->tx_rb, str, strlen(str)); /* Write data to TX buffer */
    uart_start_tx_dma_transfer(uart_buff, dma_tx);              /* Then try to start transfer */
}

/**
 * \brief           Send data to UART
 * \note            Will queue to send if DMA transfer in progress
 * \param[in]       uart_buff: UART peripheral buffers to use
 * \param[in]       data: Data to process
 * \param[in]       len: Length in units of bytes
 */
void uart_send_data(uart_buff_t* uart_buff, dma_tx_t* dma_tx, const void* data, size_t len) {
    lwrb_write(&uart_buff->tx_rb, data, len);
    uart_start_tx_dma_transfer(uart_buff, dma_tx);
}

/**
 * \brief           USART1 Initialization Function
 */
void usart1_init(void) {
    LL_USART_InitTypeDef USART_InitStruct = {0};
    LL_GPIO_InitTypeDef GPIO_InitStruct = {0};

    /* Peripheral clock enable */
    LL_APB2_GRP1_EnableClock(LL_APB2_GRP1_PERIPH_USART1);
    LL_AHB2_GRP1_EnableClock(LL_AHB2_GRP1_PERIPH_GPIOA);
    LL_AHB1_GRP1_EnableClock(LL_AHB1_GRP1_PERIPH_DMAMUX1);
    LL_AHB1_GRP1_EnableClock(LL_AHB1_GRP1_PERIPH_DMA1);

    /*
     * LPUART1 GPIO Configuration
     *
     * PA9   ------> USART1_TX
     * PA10   ------> USART1_RX
     */
    GPIO_InitStruct.Pin = LL_GPIO_PIN_9;
    GPIO_InitStruct.Mode = LL_GPIO_MODE_ALTERNATE;
    GPIO_InitStruct.Speed = LL_GPIO_SPEED_FREQ_LOW;
    GPIO_InitStruct.OutputType = LL_GPIO_OUTPUT_PUSHPULL;
    GPIO_InitStruct.Pull = LL_GPIO_PULL_NO;
    GPIO_InitStruct.Alternate = LL_GPIO_AF_7;
    LL_GPIO_Init(GPIOA, &GPIO_InitStruct);

    GPIO_InitStruct.Pin = LL_GPIO_PIN_10;
    GPIO_InitStruct.Mode = LL_GPIO_MODE_ALTERNATE;
    GPIO_InitStruct.Speed = LL_GPIO_SPEED_FREQ_LOW;
    GPIO_InitStruct.OutputType = LL_GPIO_OUTPUT_PUSHPULL;
    GPIO_InitStruct.Pull = LL_GPIO_PULL_NO;
    GPIO_InitStruct.Alternate = LL_GPIO_AF_7;
    LL_GPIO_Init(GPIOA, &GPIO_InitStruct);

    /* USART1 RX DMA init */
    LL_DMA_SetPeriphRequest(DMA1, LL_DMA_CHANNEL_3, LL_DMAMUX_REQ_USART1_RX);
    LL_DMA_SetDataTransferDirection(DMA1, LL_DMA_CHANNEL_3, LL_DMA_DIRECTION_PERIPH_TO_MEMORY);
    LL_DMA_SetChannelPriorityLevel(DMA1, LL_DMA_CHANNEL_3, LL_DMA_PRIORITY_LOW);
    LL_DMA_SetMode(DMA1, LL_DMA_CHANNEL_3, LL_DMA_MODE_CIRCULAR);
    LL_DMA_SetPeriphIncMode(DMA1, LL_DMA_CHANNEL_3, LL_DMA_PERIPH_NOINCREMENT);
    LL_DMA_SetMemoryIncMode(DMA1, LL_DMA_CHANNEL_3, LL_DMA_MEMORY_INCREMENT);
    LL_DMA_SetPeriphSize(DMA1, LL_DMA_CHANNEL_3, LL_DMA_PDATAALIGN_BYTE);
    LL_DMA_SetMemorySize(DMA1, LL_DMA_CHANNEL_3, LL_DMA_MDATAALIGN_BYTE);
    LL_DMA_SetPeriphAddress(DMA1, LL_DMA_CHANNEL_3, LL_USART_DMA_GetRegAddr(USART1, LL_USART_DMA_REG_DATA_RECEIVE));
    LL_DMA_SetMemoryAddress(DMA1, LL_DMA_CHANNEL_3, (uint32_t)usart1_buff.rx_dma_buff);
    LL_DMA_SetDataLength(DMA1, LL_DMA_CHANNEL_3, ARRAY_LEN(usart1_buff.rx_dma_buff));

    /* USART1 TX DMA init */
    LL_DMA_SetPeriphRequest(DMA1, LL_DMA_CHANNEL_4, LL_DMAMUX_REQ_USART1_TX);
    LL_DMA_SetDataTransferDirection(DMA1, LL_DMA_CHANNEL_4, LL_DMA_DIRECTION_MEMORY_TO_PERIPH);
    LL_DMA_SetChannelPriorityLevel(DMA1, LL_DMA_CHANNEL_4, LL_DMA_PRIORITY_LOW);
    LL_DMA_SetMode(DMA1, LL_DMA_CHANNEL_4, LL_DMA_MODE_NORMAL);
    LL_DMA_SetPeriphIncMode(DMA1, LL_DMA_CHANNEL_4, LL_DMA_PERIPH_NOINCREMENT);
    LL_DMA_SetMemoryIncMode(DMA1, LL_DMA_CHANNEL_4, LL_DMA_MEMORY_INCREMENT);
    LL_DMA_SetPeriphSize(DMA1, LL_DMA_CHANNEL_4, LL_DMA_PDATAALIGN_BYTE);
    LL_DMA_SetMemorySize(DMA1, LL_DMA_CHANNEL_4, LL_DMA_MDATAALIGN_BYTE);
    LL_DMA_SetPeriphAddress(DMA1, LL_DMA_CHANNEL_4, LL_USART_DMA_GetRegAddr(USART1, LL_USART_DMA_REG_DATA_TRANSMIT));

    /* Enable HT & TC interrupts for RX */
    LL_DMA_EnableIT_HT(DMA1, LL_DMA_CHANNEL_3);
    LL_DMA_EnableIT_TC(DMA1, LL_DMA_CHANNEL_3);

    /* Enable HT & TC interrupts for TX */
    LL_DMA_EnableIT_TC(DMA1, LL_DMA_CHANNEL_4);

    /* DMA interrupt init for RX & TX */
    NVIC_SetPriority(DMA1_Channel3_IRQn, NVIC_EncodePriority(NVIC_GetPriorityGrouping(), 5, 0));
    NVIC_EnableIRQ(DMA1_Channel3_IRQn);
    NVIC_SetPriority(DMA1_Channel4_IRQn, NVIC_EncodePriority(NVIC_GetPriorityGrouping(), 5, 0));
    NVIC_EnableIRQ(DMA1_Channel4_IRQn);

    /* Initialize USART1 */
    USART_InitStruct.PrescalerValue = LL_USART_PRESCALER_DIV1;
    USART_InitStruct.BaudRate = 115200;
    USART_InitStruct.DataWidth = LL_USART_DATAWIDTH_8B;
    USART_InitStruct.StopBits = LL_USART_STOPBITS_1;
    USART_InitStruct.Parity = LL_USART_PARITY_NONE;
    USART_InitStruct.TransferDirection = LL_USART_DIRECTION_TX_RX;
    USART_InitStruct.HardwareFlowControl = LL_USART_HWCONTROL_NONE;
    USART_InitStruct.OverSampling = LL_USART_OVERSAMPLING_16;
    LL_USART_Init(USART1, &USART_InitStruct);
    LL_USART_SetTXFIFOThreshold(USART1, LL_USART_FIFOTHRESHOLD_1_8);
    LL_USART_SetRXFIFOThreshold(USART1, LL_USART_FIFOTHRESHOLD_1_8);
    LL_USART_DisableFIFO(USART1);
    LL_USART_EnableDMAReq_RX(USART1);
    LL_USART_EnableDMAReq_TX(USART1);
    LL_USART_EnableIT_IDLE(USART1);

    /* UDART1 interrupt */
    NVIC_SetPriority(USART1_IRQn, NVIC_EncodePriority(NVIC_GetPriorityGrouping(), 5, 0));
    NVIC_EnableIRQ(USART1_IRQn);

    /* Associated DMA channel struct for USART1 */
    usart1_dma.controller = DMA1;
    usart1_dma.channel = LL_DMA_CHANNEL_4;
    usart1_dma.clear_flag_TC = &LL_DMA_ClearFlag_TC4;
    usart1_dma.clear_flag_GI = &LL_DMA_ClearFlag_GI4;
    usart1_dma.clear_flag_HT = &LL_DMA_ClearFlag_HT4;
    usart1_dma.clear_flag_TE = &LL_DMA_ClearFlag_TE4;

    /* Enable USART and DMA */
    LL_DMA_EnableChannel(DMA1, LL_DMA_CHANNEL_3);
    LL_USART_Enable(USART1);
    while (!LL_USART_IsActiveFlag_TEACK(USART1) || !LL_USART_IsActiveFlag_REACK(USART1)) {}
}

/**
 * \brief           LPUART1 Initialization Function
 */
void lpuart1_init(void) {
    LL_LPUART_InitTypeDef LPUART_InitStruct = {0};
    LL_GPIO_InitTypeDef GPIO_InitStruct = {0};

    /* Peripheral clock enable */
    LL_APB1_GRP2_EnableClock(LL_APB1_GRP2_PERIPH_LPUART1);
    LL_AHB2_GRP1_EnableClock(LL_AHB2_GRP1_PERIPH_GPIOA);
    LL_AHB1_GRP1_EnableClock(LL_AHB1_GRP1_PERIPH_DMAMUX1);
    LL_AHB1_GRP1_EnableClock(LL_AHB1_GRP1_PERIPH_DMA1);

    /*
     * LPUART1 GPIO Configuration
     *
     * PA2   ------> LPUART1_TX
     * PA3   ------> LPUART1_RX
     */
    GPIO_InitStruct.Pin = LL_GPIO_PIN_2;
    GPIO_InitStruct.Mode = LL_GPIO_MODE_ALTERNATE;
    GPIO_InitStruct.Speed = LL_GPIO_SPEED_FREQ_LOW;
    GPIO_InitStruct.OutputType = LL_GPIO_OUTPUT_PUSHPULL;
    GPIO_InitStruct.Pull = LL_GPIO_PULL_NO;
    GPIO_InitStruct.Alternate = LL_GPIO_AF_12;
    LL_GPIO_Init(GPIOA, &GPIO_InitStruct);

    GPIO_InitStruct.Pin = LL_GPIO_PIN_3;
    GPIO_InitStruct.Mode = LL_GPIO_MODE_ALTERNATE;
    GPIO_InitStruct.Speed = LL_GPIO_SPEED_FREQ_LOW;
    GPIO_InitStruct.OutputType = LL_GPIO_OUTPUT_PUSHPULL;
    GPIO_InitStruct.Pull = LL_GPIO_PULL_NO;
    GPIO_InitStruct.Alternate = LL_GPIO_AF_12;
    LL_GPIO_Init(GPIOA, &GPIO_InitStruct);

    /* LPUART1 RX DMA init */
    LL_DMA_SetPeriphRequest(DMA1, LL_DMA_CHANNEL_1, LL_DMAMUX_REQ_LPUART1_RX);
    LL_DMA_SetDataTransferDirection(DMA1, LL_DMA_CHANNEL_1, LL_DMA_DIRECTION_PERIPH_TO_MEMORY);
    LL_DMA_SetChannelPriorityLevel(DMA1, LL_DMA_CHANNEL_1, LL_DMA_PRIORITY_LOW);
    LL_DMA_SetMode(DMA1, LL_DMA_CHANNEL_1, LL_DMA_MODE_CIRCULAR);
    LL_DMA_SetPeriphIncMode(DMA1, LL_DMA_CHANNEL_1, LL_DMA_PERIPH_NOINCREMENT);
    LL_DMA_SetMemoryIncMode(DMA1, LL_DMA_CHANNEL_1, LL_DMA_MEMORY_INCREMENT);
    LL_DMA_SetPeriphSize(DMA1, LL_DMA_CHANNEL_1, LL_DMA_PDATAALIGN_BYTE);
    LL_DMA_SetMemorySize(DMA1, LL_DMA_CHANNEL_1, LL_DMA_MDATAALIGN_BYTE);
    LL_DMA_SetPeriphAddress(DMA1, LL_DMA_CHANNEL_1, LL_LPUART_DMA_GetRegAddr(LPUART1, LL_LPUART_DMA_REG_DATA_RECEIVE));
    LL_DMA_SetMemoryAddress(DMA1, LL_DMA_CHANNEL_1, (uint32_t)lpuart1_buff.rx_dma_buff);
    LL_DMA_SetDataLength(DMA1, LL_DMA_CHANNEL_1, ARRAY_LEN(lpuart1_buff.rx_dma_buff));

    /* LPUART1 TX DMA init */
    LL_DMA_SetPeriphRequest(DMA1, LL_DMA_CHANNEL_2, LL_DMAMUX_REQ_LPUART1_TX);
    LL_DMA_SetDataTransferDirection(DMA1, LL_DMA_CHANNEL_2, LL_DMA_DIRECTION_MEMORY_TO_PERIPH);
    LL_DMA_SetChannelPriorityLevel(DMA1, LL_DMA_CHANNEL_2, LL_DMA_PRIORITY_LOW);
    LL_DMA_SetMode(DMA1, LL_DMA_CHANNEL_2, LL_DMA_MODE_NORMAL);
    LL_DMA_SetPeriphIncMode(DMA1, LL_DMA_CHANNEL_2, LL_DMA_PERIPH_NOINCREMENT);
    LL_DMA_SetMemoryIncMode(DMA1, LL_DMA_CHANNEL_2, LL_DMA_MEMORY_INCREMENT);
    LL_DMA_SetPeriphSize(DMA1, LL_DMA_CHANNEL_2, LL_DMA_PDATAALIGN_BYTE);
    LL_DMA_SetMemorySize(DMA1, LL_DMA_CHANNEL_2, LL_DMA_MDATAALIGN_BYTE);
    LL_DMA_SetPeriphAddress(DMA1, LL_DMA_CHANNEL_2, LL_LPUART_DMA_GetRegAddr(LPUART1, LL_LPUART_DMA_REG_DATA_TRANSMIT));

    /* Enable HT & TC interrupts for RX */
    LL_DMA_EnableIT_HT(DMA1, LL_DMA_CHANNEL_1);
    LL_DMA_EnableIT_TC(DMA1, LL_DMA_CHANNEL_1);

    /* Enable HT & TC interrupts for TX */
    LL_DMA_EnableIT_TC(DMA1, LL_DMA_CHANNEL_2);

    /* DMA interrupt init for RX & TX */
    NVIC_SetPriority(DMA1_Channel1_IRQn, NVIC_EncodePriority(NVIC_GetPriorityGrouping(), 5, 0));
    NVIC_EnableIRQ(DMA1_Channel1_IRQn);
    NVIC_SetPriority(DMA1_Channel2_IRQn, NVIC_EncodePriority(NVIC_GetPriorityGrouping(), 5, 0));
    NVIC_EnableIRQ(DMA1_Channel2_IRQn);

    /* Initialize LPUART1 */
    LPUART_InitStruct.PrescalerValue = LL_LPUART_PRESCALER_DIV1;
    LPUART_InitStruct.BaudRate = 115200;
    LPUART_InitStruct.DataWidth = LL_LPUART_DATAWIDTH_8B;
    LPUART_InitStruct.StopBits = LL_LPUART_STOPBITS_1;
    LPUART_InitStruct.Parity = LL_LPUART_PARITY_NONE;
    LPUART_InitStruct.TransferDirection = LL_LPUART_DIRECTION_TX_RX;
    LPUART_InitStruct.HardwareFlowControl = LL_LPUART_HWCONTROL_NONE;
    LL_LPUART_Init(LPUART1, &LPUART_InitStruct);
    LL_LPUART_SetTXFIFOThreshold(LPUART1, LL_LPUART_FIFOTHRESHOLD_1_8);
    LL_LPUART_SetRXFIFOThreshold(LPUART1, LL_LPUART_FIFOTHRESHOLD_1_8);
    LL_LPUART_DisableFIFO(LPUART1);
    LL_LPUART_EnableDMAReq_RX(LPUART1);
    LL_LPUART_EnableDMAReq_TX(LPUART1);
    LL_LPUART_EnableIT_IDLE(LPUART1);

    /* LPUART1 interrupt */
    NVIC_SetPriority(LPUART1_IRQn, NVIC_EncodePriority(NVIC_GetPriorityGrouping(), 5, 0));
    NVIC_EnableIRQ(LPUART1_IRQn);

    /* Associated DMA channel struct for LPUART1 */
    lpuart1_dma.controller = DMA1;
    lpuart1_dma.channel = LL_DMA_CHANNEL_2;
    lpuart1_dma.clear_flag_TC = &LL_DMA_ClearFlag_TC2;
    lpuart1_dma.clear_flag_GI = &LL_DMA_ClearFlag_GI2;
    lpuart1_dma.clear_flag_HT = &LL_DMA_ClearFlag_HT2;
    lpuart1_dma.clear_flag_TE = &LL_DMA_ClearFlag_TE2;

    /* Enable LPUART and DMA */
    LL_DMA_EnableChannel(DMA1, LL_DMA_CHANNEL_1);
    LL_LPUART_Enable(LPUART1);
    while (!LL_LPUART_IsActiveFlag_TEACK(LPUART1) || !LL_LPUART_IsActiveFlag_REACK(LPUART1)) {}
}

/* Interrupt handlers here */

/**
 * \brief           DMA1 channel1 interrupt handler for LPUART1 RX
 */
void DMA1_Channel1_IRQHandler(void) {
    /* Check half-transfer complete interrupt */
    if (LL_DMA_IsEnabledIT_HT(DMA1, LL_DMA_CHANNEL_1) && LL_DMA_IsActiveFlag_HT1(DMA1)) {
        LL_DMA_ClearFlag_HT1(DMA1);             /* Clear half-transfer complete flag */
        uart_rx_check(&lpuart1_buff);                       /* Check data */
    }

    /* Check transfer-complete interrupt */
    if (LL_DMA_IsEnabledIT_TC(DMA1, LL_DMA_CHANNEL_1) && LL_DMA_IsActiveFlag_TC1(DMA1)) {
        LL_DMA_ClearFlag_TC1(DMA1);             /* Clear transfer complete flag */
        uart_rx_check(&lpuart1_buff);                       /* Check data */
    }

    /* Implement other events when needed */
}

/**
 * \brief           DMA1 channel2 interrupt handler for LPUART1 TX
 */
void DMA1_Channel2_IRQHandler(void) {
    /* Check transfer-complete interrupt */
    if (LL_DMA_IsEnabledIT_TC(DMA1, LL_DMA_CHANNEL_2) && LL_DMA_IsActiveFlag_TC2(DMA1)) {
        LL_DMA_ClearFlag_TC2(DMA1);             /* Clear transfer complete flag */
        lwrb_skip(&lpuart1_buff.tx_rb, lpuart1_buff.tx_dma_current_len);/* Skip buffer, it has been successfully sent out */
        lpuart1_buff.tx_dma_current_len = 0;           /* Reset data length */
        uart_start_tx_dma_transfer(&lpuart1_buff, &lpuart1_dma);          /* Start new transfer */
    }

    /* Implement other events when needed */
}

/**
 * \brief           DMA1 channel3 interrupt handler for USART1 RX
 */
void DMA1_Channel3_IRQHandler(void) {
    /* Check half-transfer complete interrupt */
    if (LL_DMA_IsEnabledIT_HT(DMA1, LL_DMA_CHANNEL_3) && LL_DMA_IsActiveFlag_HT1(DMA1)) {
        LL_DMA_ClearFlag_HT1(DMA1);             /* Clear half-transfer complete flag */
        uart_rx_check(&usart1_buff);                       /* Check data */
    }

    /* Check transfer-complete interrupt */
    if (LL_DMA_IsEnabledIT_TC(DMA1, LL_DMA_CHANNEL_3) && LL_DMA_IsActiveFlag_TC1(DMA1)) {
        LL_DMA_ClearFlag_TC1(DMA1);             /* Clear transfer complete flag */
        uart_rx_check(&usart1_buff);                       /* Check data */
    }

    /* Implement other events when needed */
}

/**
 * \brief           DMA1 channel4 interrupt handler for USART1 TX
 */
void DMA1_Channel4_IRQHandler(void) {
    /* Check transfer-complete interrupt */
    if (LL_DMA_IsEnabledIT_TC(DMA1, LL_DMA_CHANNEL_4) && LL_DMA_IsActiveFlag_TC4(DMA1)) {
        LL_DMA_ClearFlag_TC4(DMA1);             /* Clear transfer complete flag */
        lwrb_skip(&usart1_buff.tx_rb, usart1_buff.tx_dma_current_len);/* Skip buffer, it has been successfully sent out */
        usart1_buff.tx_dma_current_len = 0;           /* Reset data length */
        uart_start_tx_dma_transfer(&usart1_buff, &usart1_dma);          /* Start new transfer */
    }

    /* Implement other events when needed */
}

/**
 * \brief           LPUART1 global interrupt handler
 */
void LPUART1_IRQHandler(void) {
    /* Check for IDLE line interrupt */
    if (LL_LPUART_IsEnabledIT_IDLE(LPUART1) && LL_LPUART_IsActiveFlag_IDLE(LPUART1)) {
        LL_LPUART_ClearFlag_IDLE(LPUART1);      /* Clear IDLE line flag */
        uart_rx_check(&lpuart1_buff);                       /* Check data */
    }

    /* Implement other events when needed */
}

/**
 * \brief           USART1 global interrupt handler
 */
void USART1_IRQHandler(void) {
    /* Check for IDLE line interrupt */
    if (LL_USART_IsEnabledIT_IDLE(USART1) && LL_USART_IsActiveFlag_IDLE(USART1)) {
        LL_USART_ClearFlag_IDLE(USART1);      /* Clear IDLE line flag */
        uart_rx_check(&usart1_buff);                       /* Check data */
    }

    /* Implement other events when needed */
}

uint8_t find_crlf(uart_buff_t* uart_buff, size_t peekahead, uint8_t* old_char) {
    uint8_t new_char;

    lwrb_peek(&uart_buff->rx_process_rb, peekahead, &new_char, 1);
    if((*old_char == '\r') & (new_char == '\n')) {
        *old_char = new_char;
        return(1);
    }

    *old_char = new_char;
    return(0);
}

void process_char_loop(uart_buff_t* uart_buff, size_t peekahead, uint8_t* old_char) {

}

/**
 * \brief           Send string via RYLR_998
 * \param[in]       uart_buff: UART peripheral buffers to use
 * \param[in]       dma_tx: DMA associated with UART TX
 * \param[in]       address: LoRa address to send to
 * \param[in]       str: Pointer to start of string
 */
uint8_t rylr_send_string(uart_buff_t* uart_buff, dma_tx_t* dma_tx, uint16_t address, char* str) {
    size_t len;
    char buffer[20];

    len = strlen(str);
    if(len <= 240) {
        sprintf(buffer, "AT+SEND=%d,%d,", address, len);
        uart_send_string(uart_buff, dma_tx, buffer);
        uart_send_string(uart_buff, dma_tx, str);
        uart_send_string(uart_buff, dma_tx, "\r\n");
        return(0);
    }
    return(-1);
}

/**
 * \brief           Send data via RYLR_998
 * \param[in]       uart_buff: UART peripheral buffers to use
 * \param[in]       dma_tx: DMA associated with UART TX
 * \param[in]       address: LoRa address to send to
 * \param[in]       data: Pointer to start of data
 * \param[in]       len: Length of data being sent in bytes
 */
uint8_t rylr_send_data(uart_buff_t* uart_buff, dma_tx_t* dma_tx, uint16_t address, void* data, size_t len) {
    char buffer[20];

    if(len <=240) {
        sprintf(buffer, "AT+SEND=%d,%d,", address, len);
        uart_send_string(uart_buff, dma_tx, buffer);
        uart_send_data(uart_buff, dma_tx, data, len);
        uart_send_string(uart_buff, dma_tx, "\r\n");
        return(0);
    }
    return(-1);
}

/* USER CODE END 4 */

void Error_Handler(void) {
    __disable_irq();
    while (1) {
    }
}
